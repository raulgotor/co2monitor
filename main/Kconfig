## main/Kconfig
```kconfig
# Kconfig file for app configuration

menu "Application configuration"

    config CO2_MONITOR_DEVICE_URL
        string
        prompt "Thingsboard server's URL"
        default "http://dummy.server:8080"

    config CO2_MONITOR_DEVICE_TOKEN
        string
        prompt "Device token at Thingsboard server"
        default my_favorite_token

    config CO2_MONITOR_DISPLAY_BACKLIGHT_TIMEOUT_S
        int
        prompt "Backlight automatic turn off (in seconds, 0 for no automatic turn off)"
        default 60

endmenu
```
